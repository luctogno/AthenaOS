#include "Sprite.h"
#include <esp_heap_caps.h>
#include <pgmspace.h>
#include <string.h>

// Classic 5x7 font, ASCII 32..126, 5 columns per glyph, bit0 = top
static const uint8_t FONT5X7[][5] PROGMEM = {
    {0x00,0x00,0x00,0x00,0x00}, // space
    {0x00,0x00,0x5F,0x00,0x00}, // !
    {0x00,0x07,0x00,0x07,0x00}, // "
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    {0x08,0x04,0x08,0x10,0x08}, // ~
};

static inline uint16_t swapBytes(uint16_t c) {
    return (uint16_t)((c << 8) | (c >> 8));
}

bool Sprite::createSprite(int16_t w, int16_t h) {
    _w = w;
    _h = h;
    size_t bytes = (size_t)w * (size_t)h * 2;
    _buf = (uint16_t *)heap_caps_malloc(bytes, MALLOC_CAP_8BIT | MALLOC_CAP_SPIRAM);
    if (!_buf) _buf = (uint16_t *)malloc(bytes);
    if (!_buf) return false;
    memset(_buf, 0, bytes);
    return true;
}

void Sprite::drawPixel(int16_t x, int16_t y, uint16_t c) {
    if (!_buf || x < 0 || y < 0 || x >= _w || y >= _h) return;
    _buf[y * _w + x] = c;
}

void Sprite::fillSprite(uint16_t color) {
    if (!_buf) return;
    uint32_t n = (uint32_t)_w * _h;
    for (uint32_t i = 0; i < n; i++) _buf[i] = color;
}

void Sprite::fillRect(int16_t x, int16_t y, int16_t w, int16_t h, uint16_t c) {
    if (!_buf) return;
    int16_t x1 = x + w;
    int16_t y1 = y + h;
    if (x < 0) x = 0;
    if (y < 0) y = 0;
    if (x1 > _w) x1 = _w;
    if (y1 > _h) y1 = _h;
    for (int16_t j = y; j < y1; j++) {
        uint16_t *row = _buf + j * _w;
        for (int16_t i = x; i < x1; i++) row[i] = c;
    }
}

void Sprite::drawRect(int16_t x, int16_t y, int16_t w, int16_t h, uint16_t c) {
    fillRect(x, y, w, 1, c);
    fillRect(x, y + h - 1, w, 1, c);
    fillRect(x, y, 1, h, c);
    fillRect(x + w - 1, y, 1, h, c);
}

void Sprite::drawLine(int16_t x0, int16_t y0, int16_t x1, int16_t y1, uint16_t c) {
    int16_t dx = abs(x1 - x0), sx = x0 < x1 ? 1 : -1;
    int16_t dy = -abs(y1 - y0), sy = y0 < y1 ? 1 : -1;
    int16_t err = dx + dy;
    while (true) {
        drawPixel(x0, y0, c);
        if (x0 == x1 && y0 == y1) break;
        int16_t e2 = 2 * err;
        if (e2 >= dy) { err += dy; x0 += sx; }
        if (e2 <= dx) { err += dx; y0 += sy; }
    }
}

void Sprite::drawCircle(int16_t x0, int16_t y0, int16_t r, uint16_t c) {
    int16_t x = -r, y = 0, err = 2 - 2 * r;
    do {
        drawPixel(x0 - x, y0 + y, c);
        drawPixel(x0 - y, y0 - x, c);
        drawPixel(x0 + x, y0 - y, c);
        drawPixel(x0 + y, y0 + x, c);
        r = err;
        if (r <= y) err += ++y * 2 + 1;
        if (r > x || err > y) err += ++x * 2 + 1;
    } while (x < 0);
}

void Sprite::fillCircle(int16_t x0, int16_t y0, int16_t r, uint16_t c) {
    for (int16_t y = -r; y <= r; y++) {
        for (int16_t x = -r; x <= r; x++) {
            if (x * x + y * y <= r * r) drawPixel(x0 + x, y0 + y, c);
        }
    }
}

void Sprite::pushImage(int16_t x, int16_t y, int16_t w, int16_t h, const uint16_t *data) {
    pushImageSrc(x, y, w, h, data, w, h);
}

void Sprite::pushImageSrc(int16_t x, int16_t y, int16_t dw, int16_t dh,
                          const uint16_t *data, int16_t sw, int16_t sh) {
    if (!_buf || !data || dw <= 0 || dh <= 0 || sw <= 0 || sh <= 0) return;
    for (int16_t j = 0; j < dh; j++) {
        int16_t dy = y + j;
        if (dy < 0 || dy >= _h) continue;
        int16_t sy = j * sh / dh;
        uint16_t *row = _buf + dy * _w;
        const uint16_t *srow = data + sy * sw;
        for (int16_t i = 0; i < dw; i++) {
            int16_t dx = x + i;
            if (dx < 0 || dx >= _w) continue;
            uint16_t c = srow[i * sw / dw];
            if (_swap) c = swapBytes(c);
            row[dx] = c;
        }
    }
}

void Sprite::pushToSprite(Sprite *dst, int16_t x, int16_t y, uint16_t trans) {
    pushToSpriteScaled(dst, x, y, trans, 1);
}

void Sprite::pushToSpriteScaled(Sprite *dst, int16_t x, int16_t y, uint16_t trans, float scale) {
    if (!dst || !_buf || !dst->_buf) return;
    if (scale < 0.1f) scale = 1.0f;
    const int dw = (int)(_w * scale + 0.5f);
    const int dh = (int)(_h * scale + 0.5f);
    if (dw < 1 || dh < 1) return;
    for (int j = 0; j < dh; j++) {
        int sy = j * _h / dh;
        uint16_t *srow = _buf + sy * _w;
        int dy = y + j;
        if (dy < 0 || dy >= dst->_h) continue;
        uint16_t *drow = dst->_buf + dy * dst->_w;
        for (int i = 0; i < dw; i++) {
            uint16_t c = srow[i * _w / dw];
            if (c == trans) continue;
            int dx = x + i;
            if (dx < 0 || dx >= dst->_w) continue;
            drow[dx] = c;
        }
    }
}

void Sprite::pushSprite(int16_t /*x*/, int16_t /*y*/) {
    if (!_buf) return;
    Display::blit(UI_OX, UI_OY, _buf, _w, _h);
}

void Sprite::drawChar(int16_t x, int16_t y, char ch, uint16_t color, uint8_t size) {
    if (ch < 32 || ch > 126) ch = '?';
    const uint8_t *g = FONT5X7[ch - 32];
    for (uint8_t col = 0; col < 5; col++) {
        uint8_t line = pgm_read_byte(&g[col]);
        for (uint8_t row = 0; row < 7; row++) {
            if (line & (1 << row)) {
                if (size == 1) drawPixel(x + col, y + row, color);
                else fillRect(x + col * size, y + row * size, size, size, color);
            }
        }
    }
}

size_t Sprite::write(uint8_t c) {
    if (c == '\n') {
        _cx = 0;
        _cy += 8 * _textSize;
        return 1;
    }
    if (c == '\r') return 1;
    drawChar(_cx, _cy, (char)c, _text, _textSize);
    _cx += 6 * _textSize;
    return 1;
}
